## sdkconfig.defaults
```kconfig
CONFIG_IDF_TARGET="esp32s3"
CONFIG_ESPTOOLPY_FLASHSIZE_32MB=y
CONFIG_ESPTOOLPY_OCT_FLASH=y
CONFIG_ESPTOOLPY_FLASHMODE_OPI=y
CONFIG_ESPTOOLPY_FLASH_SAMPLE_MODE_STR=y
CONFIG_ESPTOOLPY_FLASHFREQ_80M=y
CONFIG_PARTITION_TABLE_CUSTOM=y
CONFIG_PARTITION_TABLE_CUSTOM_FILENAME="partitions.csv"
CONFIG_ESP_CONSOLE_USB_SERIAL_JTAG=y
CONFIG_ESP_CONSOLE_SECONDARY_NONE=y
CONFIG_ESP_MAIN_TASK_STACK_SIZE=6144
CONFIG_FREERTOS_HZ=1000
CONFIG_LWIP_SNTP_MAX_SERVERS=3
CONFIG_LWIP_SNTP_UPDATE_DELAY=3600000
CONFIG_SPIRAM=y
CONFIG_SPIRAM_MODE_OCT=y
CONFIG_SPIRAM_SPEED_80M=y
CONFIG_SPIRAM_USE_MALLOC=y
CONFIG_LV_COLOR_DEPTH_16=y
CONFIG_LV_DEF_REFR_PERIOD=33
CONFIG_LV_FONT_UNSCII_8=y
CONFIG_LV_FONT_DEFAULT_UNSCII_8=y
CONFIG_LV_USE_CANVAS=y
CONFIG_HUB75_BOARD_CUSTOM=y
CONFIG_HUB75_PANEL_WIDTH=64
CONFIG_HUB75_PANEL_HEIGHT=64
CONFIG_HUB75_LAYOUT_ROWS=1
CONFIG_HUB75_LAYOUT_COLS=1
CONFIG_HUB75_LAYOUT_HORIZONTAL=y
CONFIG_HUB75_WIRING_STANDARD=y
CONFIG_HUB75_DOUBLE_BUFFER=y
CONFIG_HUB75_BRIGHTNESS=64
CONFIG_HUB75_CLK_10MHZ=y
CONFIG_HUB75_PIN_R1=4
CONFIG_HUB75_PIN_G1=5
CONFIG_HUB75_PIN_B1=6
CONFIG_HUB75_PIN_R2=7
CONFIG_HUB75_PIN_G2=15
CONFIG_HUB75_PIN_B2=16
CONFIG_HUB75_PIN_A=18
CONFIG_HUB75_PIN_B=8
CONFIG_HUB75_PIN_C=3
CONFIG_HUB75_PIN_D=42
CONFIG_HUB75_PIN_E=9
CONFIG_HUB75_PIN_LAT=40
CONFIG_HUB75_PIN_OE=2
CONFIG_HUB75_PIN_CLK=41
```
